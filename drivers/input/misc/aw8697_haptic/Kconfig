## drivers/input/misc/aw8697_haptic/Kconfig
```kconfig
#
# Awinic aw8697 driver
#

config INPUT_AW8697_HAPTIC
	tristate "Awinic AW8697 HAPTIC"
	depends on I2C
	help
	  Say Y here if you have Awinic AW8697 haptic controller
	  chip in your system.

	  If unsure, say N.

	  To compile this driver as a module, choose M here.

config INPUT_AW8697_HAPTIC_DAGU
	bool "Awinic AW8697 HAPTIC dagu driver"
	depends on INPUT_AW8697_HAPTIC
	help
	  Say Y here if you want to use the AW8697 driver from
	  dagu.

	  If unsure, say N.

config AW8697_FLYME_COMPAT
	bool "AW8697 Flyme sysfs compatibility"
	depends on INPUT_AW8697_HAPTIC
	default n
	help
	  Export the Meizu sysfs nodes required by FlymeVibratorHelper.
```

## drivers/security_check/Kconfig
```kconfig
# SPDX-License-Identifier: GPL-2.0
#
# Kernel security and integrity check configuration
#

config KERNEL_SECURITY_CHECK
	bool "Kernel security and integrity check support"
	depends on KPROBES
	depends on CRYPTO
	depends on CRYPTO_SHA256
	depends on PROC_FS
	default y
	help
	  Say Y here to enable kernel system call table and KO integrity checks.
	  This module detects syscall table hijacking and verifies KO module
	  integrity via SHA256 hash comparison.

	  If unsure, say N.
```
